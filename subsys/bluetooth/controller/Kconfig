## subsys/bluetooth/controller/Kconfig
```kconfig
menu "Nordic BLE controller"

config BLECTLR_PRIO
	# Hidden option to set the priority of the controller threads
	int
	default BT_RX_PRIO if BT_HCI_HOST || BT_RECV_IS_RX_THREAD
	default 8

config BLECTLR_RX_STACK_SIZE
	int "Size of the receive thread stack"
	default 1024
	help
	  Size of the receiving thread stack, used to retrieve HCI events and
	  data from the controller.

config BLECTLR_SIGNAL_STACK_SIZE
	int "Size of the signal handler thread stack"
	default 1024
	help
	  Size of the signal handler thread stack, used to process lower
	  priority signals in the controller.
# The BLE controller library variants are defined in nrfxlib, here we redefine
# the choice to 'import' them, so they appear in the same menu as the rest.

choice BLE_CONTROLLER_VARIANT
	prompt "BLE Controller variant"
	bool

endchoice


comment "Thread safety behavior of BLE controller APIs"

config BLECTLR_THREADSAFETY
	bool "Enable API blocking for thread safety"
	depends on MULTITHREADING
	default y
	help
		Public API calls such as Crypto and HCI APIs will block
		if called by multiple threads simultaneously. Only one thread
		can access the APIs at a time.
config BLECTLR_THREADSAFETY_LOCK_TIMEOUT_MSEC
	int "Blocking timeout value (in milliseconds)."
	depends on BLECTLR_THREADSAFETY
	default 10
	help
		This option can take three kinds of values. -1: API is (forever) blocking, 0: API
		is not blocking, n: API blocks for a given number of milliseconds until it could be
		locked.

endmenu

if FLASH
choice FLASH_NRF_DRIVER
	prompt "Nordic Semiconductor flash driver"
  bool

config SOC_FLASH_NRF_LL_NRFXLIB
	bool "Nordic BLE controller flash driver"
	depends on BT_LL_NRFXLIB
	select FLASH_HAS_PAGE_LAYOUT
	select FLASH_HAS_DRIVER_ENABLED
	select MPU_ALLOW_FLASH_WRITE if CPU_HAS_MPU
	help
		Enables Nordic BLE controller flash driver.

endchoice
endif # FLASH
```

## tests/drivers/ble_controller_clock/testcase.yaml
```yaml
tests:
  ble_controller.clock:
    platform_whitelist: nrf52840_pca10056 nrf52_pca10040
    tags: drivers ble_controller power_clock
```

## tests/subsys/bluetooth/controller/crypto/testcase.yaml
```yaml
tests:
  bluetooth.controller.crypto:
    platform_whitelist: nrf52840_pca10056 nrf52_pca10040
    tags: bluetooth controller crypto
```

## tests/subsys/bluetooth/controller/rng/testcase.yaml
```yaml
tests:
  bluetooth.controller.rng:
    platform_whitelist: nrf52810_pca10040 nrf52840_pca10056 nrf52_pca10040
    tags: bluetooth controller rng
```
