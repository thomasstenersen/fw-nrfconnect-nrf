## CMakeLists.txt
```
#
# Copyright (c) 2019 Nordic Semiconductor ASA
#
# SPDX-License-Identifier: LicenseRef-BSD-5-Clause-Nordic
#

cmake_minimum_required(VERSION 3.8.2)
include($ENV{ZEPHYR_BASE}/cmake/app/boilerplate.cmake NO_POLICY_SCOPE)
project(NONE)

MESSAGE("Current dir:" ${CMAKE_CURRENT_SOURCE_DIR})
set(app_sources
    "${CMAKE_CURRENT_SOURCE_DIR}/src/main.c"
    "${CMAKE_CURRENT_SOURCE_DIR}/mock/ble_controller_soc_mock.c"
    "${CMAKE_CURRENT_SOURCE_DIR}/../../../../../subsys/bluetooth/controller/crypto.c"
   )
target_sources(app PRIVATE ${app_sources})

target_include_directories(app PRIVATE .)
target_include_directories(app PRIVATE ../include)
target_include_directories(app PRIVATE ${NRFXLIB_DIR}/ble_controller/include)
target_include_directories(app PRIVATE $ENV{ZEPHYR_BASE}/include/bluetooth)
target_include_directories(app PRIVATE $ENV{ZEPHYR_BASE}/subsys/bluetooth)
```

## prj.conf
```kconfig
#
# Copyright (c) 2019 Nordic Semiconductor ASA
#
# SPDX-License-Identifier: LicenseRef-BSD-5-Clause-Nordic
#

CONFIG_ZTEST=y
CONFIG_ZTEST_STACKSIZE=8192
CONFIG_TEST_USERSPACE=n
CONFIG_USERSPACE=n
CONFIG_STDOUT_CONSOLE=n
CONFIG_FLOAT=y
CONFIG_ZTEST_MOCKING=y
CONFIG_ZTEST_PARAMETER_COUNT=100
CONFIG_BT=n
CONFIG_BT_CTLR_CRYPTO=n
CONFIG_NET_BUF=y


#
# Logging Options
#
CONFIG_LOG=y
CONFIG_LOG_MODE_OVERFLOW=y
CONFIG_LOG_DEFAULT_LEVEL=3
CONFIG_LOG_OVERRIDE_LEVEL=0
CONFIG_LOG_MAX_LEVEL=3
CONFIG_LOG_INPLACE_PROCESS=y
CONFIG_LOG_PROCESS_TRIGGER_THRESHOLD=2
CONFIG_LOG_PROCESS_THREAD=n
CONFIG_LOG_BUFFER_SIZE=1024
CONFIG_LOG_STRDUP_MAX_STRING=32
CONFIG_LOG_STRDUP_BUF_COUNT=4
CONFIG_LOG_DOMAIN_ID=0
CONFIG_LOG_BACKEND_UART=y
CONFIG_LOG_BACKEND_SHOW_COLOR=y
```

## src/main.c
```c
/*
 * Copyright (c) 2019 Nordic Semiconductor ASA
 *
 * SPDX-License-Identifier: LicenseRef-BSD-5-Clause-Nordic
 */

#include <ztest.h>
#include <stdint.h>
#include <soc.h>
#include <logging/log.h>
#include "nrf_errno.h"

#include "crypto.h"
#include "ble_controller_soc.h"
#include "mock_ext.h"

#define LOG_MODULE_NAME tests_crypto
LOG_MODULE_REGISTER(LOG_MODULE_NAME, LOG_LEVEL_DBG);

#define KEYSIZE (16)

void test_bt_rand(void)
{
	u8_t rand_num[5];

	LOG_INF("bt_rand() @ 0x%08x\n", (uintptr_t)bt_rand);

	/* Test function call */
	zassert_equal(bt_rand(rand_num, sizeof(rand_num)), 0, "Failed");
}

void test_bt_encrypt_le(void)
{
	u8_t key_in[KEYSIZE];
	u8_t cleartext_in[KEYSIZE] = { 'C' };
	u8_t ciphertext_out[KEYSIZE] = { 0 };

	memset(key_in, 'K', KEYSIZE);
	memset(cleartext_in, 'C', KEYSIZE);
	memset(ciphertext_out, 0, KEYSIZE);

	mock_expect(ble_controller_ecb_block_encrypt);
	ztest_returns_value(ble_controller_ecb_block_encrypt, 0);
	zassert_equal(bt_encrypt_le(key_in, cleartext_in, ciphertext_out), 0, "Failed");

	/* Test custom mock behavior, this ensures that API's internal transformation on inputs (if any)
	   works correctly. */
	for (u8_t i = 0; i < KEYSIZE; i++) {
		zassert_equal(ciphertext_out[i], key_in[i] ^ cleartext_in[i], "Failed");
	}
}

void test_bt_encrypt_be(void)
{
	u8_t key_in[KEYSIZE];
	u8_t cleartext_in[KEYSIZE] = { 'C' };
	u8_t ciphertext_out[KEYSIZE] = { 0 };

	memset(key_in, 'K', KEYSIZE);
	memset(cleartext_in, 'C', KEYSIZE);
	memset(ciphertext_out, 0, KEYSIZE);

	mock_expect(ble_controller_ecb_block_encrypt);
	ztest_returns_value(ble_controller_ecb_block_encrypt, 0);
	zassert_equal(bt_encrypt_be(key_in, cleartext_in, ciphertext_out), 0, "Failed");

	/* Test custom mock behavior, this ensures that API's internal transformation on inputs (if any)
	   works correctly. */
	for (u8_t i = 0; i < KEYSIZE; i++) {
		zassert_equal(ciphertext_out[i], key_in[i] ^ cleartext_in[i], "Failed");
	}
}

void test_main(void)
{
	ztest_test_suite(test_crypto,
			 ztest_unit_test(test_bt_rand),
			 ztest_unit_test(test_bt_encrypt_le),
			 ztest_unit_test(test_bt_encrypt_be));
	ztest_run_test_suite(test_crypto);
}
```
