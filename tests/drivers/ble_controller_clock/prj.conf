## CMakeLists.txt
```
#
# Copyright (c) 2019 Nordic Semiconductor ASA
#
# SPDX-License-Identifier: LicenseRef-BSD-5-Clause-Nordic
#

cmake_minimum_required(VERSION 3.8.2)
include($ENV{ZEPHYR_BASE}/cmake/app/boilerplate.cmake NO_POLICY_SCOPE)
project(NONE)

MESSAGE("Current dir:" ${CMAKE_CURRENT_SOURCE_DIR})
set(app_sources
    "${CMAKE_CURRENT_SOURCE_DIR}/src/main.c"
    "${CMAKE_CURRENT_SOURCE_DIR}/../../../subsys/bluetooth/controller/power_clock.c"
   )

set(OPTIONS
    -DUNIT_TEST
    -DCONFIG_CLOCK_CONTROL_NRF5_M16SRC_DRV_NAME="clk_m16src"
    -DCONFIG_CLOCK_CONTROL_NRF5_K32SRC_DRV_NAME="clk_k32src"
    )
target_sources(app PRIVATE ${app_sources})

target_compile_options(app PRIVATE ${OPTIONS})

target_include_directories(app PRIVATE .)
target_include_directories(app PRIVATE include)
target_include_directories(app PRIVATE ${NRFXLIB_DIR}/ble_controller/include)
target_include_directories(app PRIVATE $ENV{ZEPHYR_BASE}/include/bluetooth)
```

## prj.conf
```kconfig
#
# Copyright (c) 2019 Nordic Semiconductor ASA
#
# SPDX-License-Identifier: LicenseRef-BSD-5-Clause-Nordic
#

CONFIG_ZTEST=y
CONFIG_ZTEST_STACKSIZE=8192
CONFIG_TEST_USERSPACE=n
CONFIG_USERSPACE=n
CONFIG_STDOUT_CONSOLE=n
CONFIG_ZTEST_MOCKING=y
CONFIG_ZTEST_PARAMETER_COUNT=50
CONFIG_NRF_RTC_TIMER=n

#
# Logging Options
#
CONFIG_LOG=y
CONFIG_LOG_MODE_OVERFLOW=y
CONFIG_LOG_DEFAULT_LEVEL=3
CONFIG_LOG_OVERRIDE_LEVEL=0
CONFIG_LOG_MAX_LEVEL=3
#CONFIG_LOG_FUNCTION_NAME=n
CONFIG_LOG_INPLACE_PROCESS=y
CONFIG_LOG_PROCESS_TRIGGER_THRESHOLD=2
CONFIG_LOG_PROCESS_THREAD=n
CONFIG_LOG_BUFFER_SIZE=1024
CONFIG_LOG_STRDUP_MAX_STRING=32
CONFIG_LOG_STRDUP_BUF_COUNT=4
CONFIG_LOG_DOMAIN_ID=0
CONFIG_LOG_BACKEND_UART=y
CONFIG_LOG_BACKEND_SHOW_COLOR=y
```

## src/main.c
```c
/*
 * Copyright (c) 2019 Nordic Semiconductor ASA
 *
 * SPDX-License-Identifier: LicenseRef-BSD-5-Clause-Nordic
 */

#include <ztest.h>
#include <stdint.h>
#include <soc.h>
#include <logging/log.h>
#include "nrf_errno.h"

#include "ble_controller_soc.h"

#define LOG_MODULE_NAME test_ble_controller_clock
LOG_MODULE_REGISTER(LOG_MODULE_NAME, LOG_LEVEL_DBG);

void test_stub(void)
{
    /* No-op. */
}

void test_main(void)
{
    ztest_test_suite(test_ble_controller_clock,
	                 ztest_unit_test(test_stub));
    ztest_run_test_suite(test_ble_controller_clock);
}
```
